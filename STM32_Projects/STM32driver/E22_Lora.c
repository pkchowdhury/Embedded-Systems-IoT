#include "stm32f4xx.h"
#include "stm32f401xc.h"                  // Device header
#include "stm32f4xx_UART.h"
#include "stm32f4xx_Delay.h"
#include "stm32f4xx_SPI.h"
#include <string.h>
#include "stdbool.h"
#include "stdio.h"
#include "E22_Lora.h"
//Lora pins
// M0_230 PB6
// M1_230 PB5
// RX_230 PA9
// TX_230 PA10
// AUX_230 PB4


void loraInit(void)
{	
    Serial1_Begin(9600);
    RCC->AHB1ENR |= RCC_AHB1ENR_GPIOBEN; //Enable Clock

    //Set PB4, PB5, PB6 as output
    GPIOB->MODER |= GPIO_MODER_MODE5_0;
    GPIOB->MODER |= GPIO_MODER_MODE4_0; 
    GPIOB->MODER |= GPIO_MODER_MODE6_0;
    // loraMode(3); //Deep Sleep Mode
    // SysTickDelayMs(100);

    // loraMode(0); // Normal Mode
    SysTickDelayMs(100);
}

void setDataSetting(void){
   
    loraMode(2);// Configuration Mode

    Serial1_write(11000000); //Write Mode
    Serial1_write(00); // starting address
    Serial1_write(0111); //7 parameter
    Serial1_write(1011); //ADDH
    Serial1_write(10110); //ADDL
    Serial1_write(00); //NETID
    Serial1_write(01100010); // 011 00 000 (9600 8N1 0.3K)
    Serial1_write(00); //00 for 30dbm, 01 for 27dbm
    Serial1_write(1); //OT channel
    Serial1_write(01000011);  

    SysTickDelayMs(500);
}
char sendData(char data){

    loraMode(0); //Normal Mode

    SysTickDelayMs(500);

    Serial1_write(00001011); //ADDH
    Serial1_write(00010110); //ADDL
    Serial1_write(00000001); //OT channel
    Serial1_write(data); //data

    SysTickDelayMs(100);

    return data;
    
}


void loraMode(int modeType){
    if(modeType == 0){ 
    //Initiate Normal Mode on LoRa
    GPIOB->ODR = 0 << 5; //set M0 low
    GPIOB->ODR = 0 << 6; //set M1 low
    }
    else if(modeType == 1){
        
    //Initiate WOR Mode on LoRa
    GPIOB->ODR = 1 << 5; //set M0 low
    GPIOB->ODR = 0 << 6; //set M1 low
    }
    else if(modeType == 2){
        
    //Initiate Configure Mode on LoRa
    GPIOB->ODR = 0 << 5; //set M0 low
    GPIOB->ODR = 1 << 6; //set M1 low
    }
    else if(modeType == 3){
        
    //Initiate Deep Sleep Mode on LoRa
    GPIOB->ODR = 1 << 5; //set M0 low
    GPIOB->ODR = 1 << 6; //set M1 low
    }

}

const unsigned char r_crctable[256] = { //reversed, 8-bit, poly=0x07
  0x00, 0x91, 0xE3, 0x72, 0x07, 0x96, 0xE4, 0x75,
  0x0E, 0x9F, 0xED, 0x7C, 0x09, 0x98, 0xEA, 0x7B,
  0x1C, 0x8D, 0xFF, 0x6E, 0x1B, 0x8A, 0xF8, 0x69,
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  0xBA, 0x2B, 0x59, 0xC8, 0xBD, 0x2C, 0x5E, 0xCF
};

unsigned char CRC8(const unsigned char *input, int count) {
  unsigned char fcs = 0xFF;
  int i;
  for (i = 0; i < count; i++) {
    fcs = r_crctable[fcs ^ input[i]];
  }
  return (0xFF - fcs);
}

